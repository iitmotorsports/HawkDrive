VERSION "1.0"

NS_ :

BU_: ECU_Engine ECU_Dashboard

BO_ 256 EngineData: 8 ECU_Engine
 SG_ Engine_RPM : 0|16@1+ (0.25,0) [0|16383] "RPM" ECU_Dashboard
